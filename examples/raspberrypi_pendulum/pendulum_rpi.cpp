/**
 * pendulum_rpi.cpp
 * ----------------
 * Real-time simple pendulum simulation generated by MechanicsDSL,
 * deployed on Raspberry Pi with pigpio for GPIO output and
 * real-time scheduling via POSIX threads.
 *
 * System specification (MechanicsDSL DSL):
 *   \system{pendulum}
 *   \parameter{m}{1.0}{kg}
 *   \parameter{l}{0.25}{m}
 *   \lagrangian{0.5*m*l^2*\dot{theta}^2 - m*g*l*(1 - cos(theta))}
 *   \target{raspberry_pi}
 *
 * Hardware:
 *   - Raspberry Pi 3B+ / 4 (tested)
 *   - MPU6050 IMU on I2C bus 1 (SDA=GPIO2, SCL=GPIO3)
 *   - Optional: LED on GPIO17 for energy-drift alert
 *
 * Dependencies:
 *   sudo apt-get install pigpio libpigpio-dev
 *   g++ -O2 -o pendulum_rpi pendulum_rpi.cpp -lpigpio -lpthread -lm
 *
 * Output (stdout, CSV):
 *   t_s,theta_rad,omega_rad_s,energy_J,energy_drift
 *
 * Author: MechanicsDSL (github.com/MechanicsDSL)
 * License: MIT
 */

#include <cmath>
#include <cstdio>
#include <cstdlib>
#include <cstring>
#include <csignal>
#include <pthread.h>
#include <sched.h>
#include <pigpio.h>

// ---------------------------------------------------------------------------
// Physical parameters
// ---------------------------------------------------------------------------
static constexpr double M_MASS = 1.0;    // kg
static constexpr double L_LEN  = 0.25;   // m
static constexpr double G_GRAV = 9.81;   // m/s^2

// ---------------------------------------------------------------------------
// Integrator configuration
// ---------------------------------------------------------------------------
static constexpr double  DT_S      = 0.004;           // 250 Hz
static constexpr unsigned DT_US    = 4000;             // microseconds
static constexpr double  DRIFT_TOL = 1e-4;             // energy drift alert

// GPIO
static constexpr unsigned GPIO_ALERT = 17;

// ---------------------------------------------------------------------------
// State
// ---------------------------------------------------------------------------
struct State {
    double theta = 0.30;   // rad
    double omega = 0.00;   // rad/s
    double t     = 0.00;   // s
};

static volatile bool g_running = true;

// ---------------------------------------------------------------------------
// MechanicsDSL-generated: equation of motion
// d(omega)/dt = -(g/l)*sin(theta)
// ---------------------------------------------------------------------------
static inline double eom_domega(double theta_val) {
    return -(G_GRAV / L_LEN) * std::sin(theta_val);
}

// ---------------------------------------------------------------------------
// MechanicsDSL-generated: Hamiltonian (Noether conserved energy)
// H = 0.5*m*l^2*omega^2 + m*g*l*(1-cos(theta))
// ---------------------------------------------------------------------------
static inline double hamiltonian(double theta_val, double omega_val) {
    const double T = 0.5 * M_MASS * L_LEN * L_LEN * omega_val * omega_val;
    const double V = M_MASS * G_GRAV * L_LEN * (1.0 - std::cos(theta_val));
    return T + V;
}

// ---------------------------------------------------------------------------
// Runge-Kutta 4 integrator
// ---------------------------------------------------------------------------
static void rk4_step(State& s, double dt) {
    const double k1_th = s.omega;
    const double k1_om = eom_domega(s.theta);

    const double k2_th = s.omega + 0.5 * dt * k1_om;
    const double k2_om = eom_domega(s.theta + 0.5 * dt * k1_th);

    const double k3_th = s.omega + 0.5 * dt * k2_om;
    const double k3_om = eom_domega(s.theta + 0.5 * dt * k2_th);

    const double k4_th = s.omega + dt * k3_om;
    const double k4_om = eom_domega(s.theta + dt * k3_th);

    s.theta += (dt / 6.0) * (k1_th + 2*k2_th + 2*k3_th + k4_th);
    s.omega += (dt / 6.0) * (k1_om + 2*k2_om + 2*k3_om + k4_om);
    s.t     += dt;
}

// ---------------------------------------------------------------------------
// Signal handler
// ---------------------------------------------------------------------------
static void signal_handler(int) { g_running = false; }

// ---------------------------------------------------------------------------
// Real-time control thread
// ---------------------------------------------------------------------------
static void* control_thread(void*) {
    // Elevate scheduling priority
    sched_param sp{};
    sp.sched_priority = sched_get_priority_max(SCHED_FIFO);
    pthread_setschedparam(pthread_self(), SCHED_FIFO, &sp);

    State s;
    const double E0 = hamiltonian(s.theta, s.omega);

    // Print CSV header
    std::printf("t_s,theta_rad,omega_rad_s,energy_J,energy_drift\n");

    while (g_running) {
        const uint32_t t_start = gpioTick();

        rk4_step(s, DT_S);

        const double E      = hamiltonian(s.theta, s.omega);
        const double drift  = std::abs((E - E0) / E0);

        // GPIO alert on energy drift (Noether monitor)
        gpioWrite(GPIO_ALERT, drift > DRIFT_TOL ? 1 : 0);

        std::printf("%.6f,%.9f,%.9f,%.9f,%.4e\n",
                    s.t, s.theta, s.omega, E, drift);

        // Busy-wait to maintain precise 250 Hz loop
        while (gpioTick() - t_start < DT_US) { /* spin */ }
    }

    gpioWrite(GPIO_ALERT, 0);
    return nullptr;
}

// ---------------------------------------------------------------------------
// Main
// ---------------------------------------------------------------------------
int main() {
    std::signal(SIGINT,  signal_handler);
    std::signal(SIGTERM, signal_handler);

    if (gpioInitialise() < 0) {
        std::fprintf(stderr, "Error: pigpio initialisation failed. "
                              "Run as root or with sudo.\n");
        return EXIT_FAILURE;
    }

    gpioSetMode(GPIO_ALERT, PI_OUTPUT);
    gpioWrite(GPIO_ALERT, 0);

    std::fprintf(stderr, "MechanicsDSL pendulum simulation starting at 250 Hz.\n");
    std::fprintf(stderr, "Parameters: m=%.2f kg, l=%.3f m, g=%.4f m/s^2\n",
                 M_MASS, L_LEN, G_GRAV);
    std::fprintf(stderr, "Press Ctrl+C to stop.\n\n");

    pthread_t thread;
    pthread_create(&thread, nullptr, control_thread, nullptr);
    pthread_join(thread, nullptr);

    gpioTerminate();
    std::fprintf(stderr, "\nSimulation stopped.\n");
    return EXIT_SUCCESS;
}
