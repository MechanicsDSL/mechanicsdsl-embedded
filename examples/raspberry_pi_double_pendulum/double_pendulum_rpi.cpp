/**
 * double_pendulum_rpi.cpp
 * -----------------------
 * Double pendulum simulation generated by MechanicsDSL, deployed on
 * Raspberry Pi with pigpio and POSIX real-time scheduling at 200 Hz.
 *
 * DSL specification:
 *   \system{double_pendulum}
 *   \parameter{m}{1.0}{kg}
 *   \parameter{l}{0.3}{m}
 *   \lagrangian{
 *       0.5*m*l^2*(2*\dot{theta1}^2 + \dot{theta2}^2
 *                  + 2*\dot{theta1}*\dot{theta2}*cos(theta1-theta2))
 *       + m*g*l*(2*cos(theta1) + cos(theta2))
 *   }
 *   \target{raspberry_pi}
 *
 * Build:
 *   mkdir build && cd build && cmake .. && make
 * Run:
 *   sudo ./double_pendulum_rpi
 *
 * Author: MechanicsDSL (github.com/MechanicsDSL)
 * License: MIT
 */

#include <cmath>
#include <cstdio>
#include <csignal>
#include <pthread.h>
#include <sched.h>
#include <pigpio.h>

static constexpr double M_MASS   = 1.0;
static constexpr double L_LEN    = 0.3;
static constexpr double G_GRAV   = 9.81;
static constexpr double DT_S     = 0.005;
static constexpr unsigned DT_US  = 5000;
static constexpr double DRIFT_TOL = 1e-4;
static constexpr unsigned GPIO_ALERT = 17;

static volatile bool g_running = true;
static void sig_handler(int) { g_running = false; }

struct State { double th1=0.8, th2=0.4, w1=0.0, w2=0.0, t=0.0; };

// MechanicsDSL-generated EOM
static void eom(double th1, double th2, double w1, double w2,
                double& dth1, double& dth2, double& dw1, double& dw2) {
    const double delta = th1 - th2;
    const double cd = std::cos(delta), sd = std::sin(delta);
    const double den = L_LEN * (2.0 - cd*cd);
    dth1 = w1; dth2 = w2;
    dw1 = ((-G_GRAV*2.0*std::sin(th1)) - sd*(w2*w2*L_LEN + w1*w1*L_LEN*cd)) / den;
    dw2 = (sd*(2.0*w1*w1*L_LEN + G_GRAV*std::cos(th1) + w2*w2*L_LEN*cd)) / den;
}

// MechanicsDSL-generated Hamiltonian
static double hamiltonian(const State& s) {
    double T = 0.5*M_MASS*L_LEN*L_LEN*(2*s.w1*s.w1 + s.w2*s.w2 + 2*s.w1*s.w2*std::cos(s.th1-s.th2));
    double V = -M_MASS*G_GRAV*L_LEN*(2*std::cos(s.th1) + std::cos(s.th2));
    return T + V;
}

static void rk4_step(State& s, double dt) {
    double k1_th1,k1_th2,k1_w1,k1_w2, k2_th1,k2_th2,k2_w1,k2_w2,
           k3_th1,k3_th2,k3_w1,k3_w2, k4_th1,k4_th2,k4_w1,k4_w2;
    eom(s.th1,s.th2,s.w1,s.w2, k1_th1,k1_th2,k1_w1,k1_w2);
    eom(s.th1+0.5*dt*k1_th1, s.th2+0.5*dt*k1_th2, s.w1+0.5*dt*k1_w1, s.w2+0.5*dt*k1_w2, k2_th1,k2_th2,k2_w1,k2_w2);
    eom(s.th1+0.5*dt*k2_th1, s.th2+0.5*dt*k2_th2, s.w1+0.5*dt*k2_w1, s.w2+0.5*dt*k2_w2, k3_th1,k3_th2,k3_w1,k3_w2);
    eom(s.th1+dt*k3_th1, s.th2+dt*k3_th2, s.w1+dt*k3_w1, s.w2+dt*k3_w2, k4_th1,k4_th2,k4_w1,k4_w2);
    s.th1 += (dt/6.0)*(k1_th1+2*k2_th1+2*k3_th1+k4_th1);
    s.th2 += (dt/6.0)*(k1_th2+2*k2_th2+2*k3_th2+k4_th2);
    s.w1  += (dt/6.0)*(k1_w1 +2*k2_w1 +2*k3_w1 +k4_w1);
    s.w2  += (dt/6.0)*(k1_w2 +2*k2_w2 +2*k3_w2 +k4_w2);
    s.t   += dt;
}

static void* control_thread(void*) {
    sched_param sp{}; sp.sched_priority = sched_get_priority_max(SCHED_FIFO);
    pthread_setschedparam(pthread_self(), SCHED_FIFO, &sp);
    State s;
    const double E0 = hamiltonian(s);
    std::printf("t_s,theta1_rad,theta2_rad,omega1_rad_s,omega2_rad_s,energy_J,energy_drift\n");
    while (g_running) {
        const uint32_t t0 = gpioTick();
        rk4_step(s, DT_S);
        const double E = hamiltonian(s);
        const double drift = std::abs((E-E0)/E0);
        gpioWrite(GPIO_ALERT, drift > DRIFT_TOL ? 1 : 0);
        std::printf("%.6f,%.9f,%.9f,%.9f,%.9f,%.9f,%.4e\n",
                    s.t, s.th1, s.th2, s.w1, s.w2, E, drift);
        while (gpioTick()-t0 < DT_US) {}
    }
    gpioWrite(GPIO_ALERT, 0);
    return nullptr;
}

int main() {
    std::signal(SIGINT, sig_handler);
    if (gpioInitialise() < 0) { std::fprintf(stderr,"pigpio init failed\n"); return 1; }
    gpioSetMode(GPIO_ALERT, PI_OUTPUT);
    std::fprintf(stderr,"MechanicsDSL double pendulum at 200 Hz. Ctrl+C to stop.\n");
    pthread_t thread;
    pthread_create(&thread, nullptr, control_thread, nullptr);
    pthread_join(thread, nullptr);
    gpioTerminate();
    return 0;
}
